#include "stdlib.h"
#include "emfat.h"
#include "main.h"

#define README_SIZE  	256		//including string length itoa "Version_MSD_2"
#define INDEX_SIZE		256
#define TEST_SIZE		1367


const char readme_file[] =
	"Firmware version ";


const char index_file [] =
		"<html><head><meta http-equiv=\"refresh\" content=\"0; url=https://plutongroup.github.io/MSD_Zigbee/\"/><title>MSD_Zigbee Shortcut</title></head><body></body></html>";


const char test_file[TEST_SIZE] =  {
	0x52, 0x61, 0x72, 0x21, 0x1A, 0x07, 0x01, 0x00, 0xF3, 0xE1, 0x82, 0xEB, 0x0B, 0x01, 0x05, 0x07, 
	0x00, 0x06, 0x01, 0x01, 0x80, 0x80, 0x80, 0x00, 0x9F, 0xB9, 0xAA, 0x21, 0x34, 0x02, 0x03, 0x0B, 
	0xFE, 0x89, 0x00, 0x04, 0xC8, 0xFF, 0x01, 0x20, 0x69, 0x82, 0xE6, 0x25, 0x80, 0x03, 0x00, 0x16, 
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	0x77, 0x56, 0x51, 0x03, 0x05, 0x04, 0x00
};

// FAT32
emfat_t emfat;

//callback 
//void autorun_read_proc(uint8_t *dest, int size, uint32_t offset, size_t userdata);
//void icon_read_proc(uint8_t *dest, int size, uint32_t offset, size_t userdata);
void readme_read_proc(uint8_t *dest, int size, uint32_t offset, size_t userdata);
void index_read_proc(uint8_t *dest, int size, uint32_t offset, size_t userdata);
void test_read_proc(uint8_t *dest, int size, uint32_t offset, size_t userdata);
void drivers_read_proc(uint8_t *dest, int size, uint32_t offset, size_t userdata);

#define CMA_TIME EMFAT_ENCODE_CMA_TIME(9,8,2020, 13,0,0)
#define CMA { CMA_TIME, CMA_TIME, CMA_TIME }

// data table
 volatile emfat_entry_t entries[] =
{
	// name          dir    lvl offset  size             max_size        user  time  read               write
	{ "",            true,  0,  0,      0,               0,              0,    CMA,  NULL,              NULL }, // root
	{ "index.htm",   false, 1,  0,      INDEX_SIZE,      INDEX_SIZE,     0,    CMA,  index_read_proc,   NULL }, // index.html
	{ "readme.txt",  false, 1,  0,      README_SIZE,     README_SIZE,    0,    CMA,  readme_read_proc,  NULL }, // readme.txt
	{ "test.zip",  	 false, 1,  0,      TEST_SIZE,       TEST_SIZE,      0,    CMA,  test_read_proc,    NULL }, // test.rar
	{ NULL }
};
/*
static emfat_entry_t entries[] =
{
	// name          dir    lvl offset  size             max_size        user  read               write
	{ "",            true,  0,  0,      0,               0,              0,    NULL,              NULL }, // root
	{ "autorun.inf", false, 1,  0,      AUTORUN_SIZE,    1*1024*1024*1024,   0,    autorun_read_proc, NULL }, // autorun.inf
	{ "icon.ico",    false, 1,  0,      ICON_SIZE,       1*1024*1024*1024,      0,    icon_read_proc,    NULL }, // icon.ico
	{ "drivers",     true,  1,  0,      0,               0,              0,    NULL,              NULL }, // drivers/
	{ "readme.txt",  false, 2,  0,      README_SIZE,     1*1024*1024*1024,    0,    readme_read_proc,  NULL }, // drivers/readme.txt
	{ "abc.txt",  false, 2,  0,      README_SIZE,     1*1024*1024*1024-32768+8192,    0,    readme_read_proc,  NULL }, // drivers/readme.txt
	{ NULL }
};
*/

 void test_read_proc(uint8_t *dest, int size, uint32_t offset, size_t userdata)
 {
 	int len = 0;
 	if (offset > TEST_SIZE) return;
 	if (offset + size > TEST_SIZE)
 		len = TEST_SIZE - offset; else
 		len = size;
 	memcpy(dest, &test_file[offset], len);
 }

void readme_read_proc(uint8_t *dest, int size, uint32_t offset, size_t userdata)
{
	int32_t end=0, cur, len = 0;
	int32_t Len_String;
	if (offset > README_SIZE) return;
	if (offset + size > README_SIZE)
		len = README_SIZE - offset; else
		len = size;
	char ver_s[8];
	__itoa (VERSION, ver_s, 10);
	end = strlen(&ver_s[0]);
	Len_String = strlen(&readme_file[0]);
	for (uint32_t i = 0; i < len; i++)
	{
		if ((offset+i) < Len_String)
		{
			dest[i]	= readme_file[offset+i];
		}
		else
		{
			cur = (offset+i) - Len_String;
			if (cur<(1+end))
			{
				if(cur==(1))
				{
					dest[i]	= '.';
				}
				else if(cur>(1))
				{
					dest[i]	= ver_s[cur-1];
				}
				else
				{
					dest[i]	= ver_s[cur];
				}
			}
			else
			{
				dest[i]=' ';
			}
		}
	}
}

void index_read_proc(uint8_t *dest, int size, uint32_t offset, size_t userdata)
{
	int32_t Len_String;
	int len = 0;
	if (offset > INDEX_SIZE) return;
	if (offset + size > INDEX_SIZE)
		len = INDEX_SIZE - offset; else
		len = size;

	Len_String = strlen(&index_file[0]);
	for (uint32_t i = 0; i < len; i++)
	{
		if ((offset+i) < Len_String)
		{
			dest[i]	= index_file[offset+i];
		}
		else
		{
			dest[i]=' ';
		}
	}
}
