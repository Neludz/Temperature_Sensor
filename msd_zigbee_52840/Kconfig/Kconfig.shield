## msd_zigbee_52840/Kconfig/Kconfig.shield
```kconfig
osource "d:/gg_project/MS_Workspace_10kV//boards/shields/*/Kconfig.shield"
osource "d:/gg_project/MS_Workspace_10kV/Temperature_Sensor/boards/shields/*/Kconfig.shield"
osource "d:/gg_project/MS_Workspace_10kV/Temperature_Router/boards/shields/*/Kconfig.shield"
osource "d:/gg_project/MS_Workspace_10kV/shell_test/boards/shields/*/Kconfig.shield"
osource "d:/gg_project/MS_Workspace_10kV/light_bulb/boards/shields/*/Kconfig.shield"
osource "d:/gg_project/MS_Workspace_10kV/network_coordinator/boards/shields/*/Kconfig.shield"
osource "d:/gg_project/MS_Workspace_10kV/Temperature_coordinator/boards/shields/*/Kconfig.shield"
osource "d:/gg_project/MS_Workspace_10kV/watchdog/boards/shields/*/Kconfig.shield"
osource "D:/Nordic/NRF_CONNECT_SDK/v1.9.1/nrf/boards/shields/*/Kconfig.shield"
```

## msd_zigbee_52840/Kconfig/Kconfig.shield.defconfig
```kconfig
osource "d:/gg_project/MS_Workspace_10kV//boards/shields/*/Kconfig.defconfig"
osource "d:/gg_project/MS_Workspace_10kV/Temperature_Sensor/boards/shields/*/Kconfig.defconfig"
osource "d:/gg_project/MS_Workspace_10kV/Temperature_Router/boards/shields/*/Kconfig.defconfig"
osource "d:/gg_project/MS_Workspace_10kV/shell_test/boards/shields/*/Kconfig.defconfig"
osource "d:/gg_project/MS_Workspace_10kV/light_bulb/boards/shields/*/Kconfig.defconfig"
osource "d:/gg_project/MS_Workspace_10kV/network_coordinator/boards/shields/*/Kconfig.defconfig"
osource "d:/gg_project/MS_Workspace_10kV/Temperature_coordinator/boards/shields/*/Kconfig.defconfig"
osource "d:/gg_project/MS_Workspace_10kV/watchdog/boards/shields/*/Kconfig.defconfig"
osource "D:/Nordic/NRF_CONNECT_SDK/v1.9.1/nrf/boards/shields/*/Kconfig.defconfig"
```
